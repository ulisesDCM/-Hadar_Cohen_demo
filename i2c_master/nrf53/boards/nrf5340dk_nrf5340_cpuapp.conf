## i2c_slave/nrf52/build_nrf52_slave/Kconfig/Kconfig.shield
```kconfig
osource "c:/users/ulise/repos/-hadar_cohen_demo/i2c_slave/nrf52/boards/shields/*/Kconfig.shield"
osource "C:/ncs/v2.7.0/nrf/boards/shields/*/Kconfig.shield"
```

## i2c_slave/nrf52/build_nrf52_slave/Kconfig/Kconfig.shield.defconfig
```kconfig
osource "c:/users/ulise/repos/-hadar_cohen_demo/i2c_slave/nrf52/boards/shields/*/Kconfig.defconfig"
osource "C:/ncs/v2.7.0/nrf/boards/shields/*/Kconfig.defconfig"
```
