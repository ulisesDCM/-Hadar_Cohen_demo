## CMakeLists.txt
```
cmake_minimum_required(VERSION 3.20.0)
find_package(Zephyr REQUIRED HINTS $ENV{ZEPHYR_BASE})
project(i2c_slave)
target_sources(app PRIVATE src/main.c)
```

## prj.conf
```kconfig
# DISABLE RTT
CONFIG_USE_SEGGER_RTT=n
CONFIG_RTT_CONSOLE=n

# Enable UART
CONFIG_UART_CONSOLE=y
CONFIG_SERIAL=y
CONFIG_LOG_BACKEND_RTT=n
CONFIG_LOG_BACKEND_UART=y
CONFIG_UART_CONSOLE=y

# Random number generator  
CONFIG_TEST_RANDOM_GENERATOR=y
```

## boards/nrf52dk_nrf52832.conf
```kconfig
CONFIG_NRFX_TWIS0=y
```

## boards/nrf52dk_nrf52832.overlay
```dts
#include "../common/common-pinctrl.dtsi"

&i2c0 {
    status = "okay";
    compatible = "nordic,nrf-twis";
    pinctrl-0 = <&i2c_slave_dummy>;
};
```

## src/main.c
```c
#include <zephyr/kernel.h>
#include <zephyr/logging/log.h>
#include <SEGGER_RTT.h>

/* Init log module */
LOG_MODULE_REGISTER(i2c_slave, LOG_LEVEL_INF);

int main(void)
{
    /* Init segger RTT */
    SEGGER_RTT_Init();

    // Buffer to store received data
    uint8_t rtt_buffer[64];

    // Send message via RTT
    const char message[] = "Hello via RTT\n";
    SEGGER_RTT_WriteString(0, message);

    while(1)
    {
        // Read data from RTT
        unsigned int num_bytes = SEGGER_RTT_Read(0, rtt_buffer, sizeof(rtt_buffer));

        // If there is data received, process it
        if (num_bytes > 0) {
            // For demonstration, print the received data
            SEGGER_RTT_WriteString(0, "Received: ");
            SEGGER_RTT_Write(0, rtt_buffer, num_bytes);
            SEGGER_RTT_WriteString(0, "\n");
        }

        // Your application code
        k_sleep(K_MSEC(1000));
    }
}
```
